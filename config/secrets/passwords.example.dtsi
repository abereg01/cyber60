/*
 * Placeholder password macros, used whenever config/secrets/passwords.dtsi
 * doesn't exist (GitHub Actions, a fresh clone). They type nothing.
 *
 * The real file is gitignored and made on the build box with
 *   python3 tools/make-passwords.py
 * and only goes into firmware built locally with tools/build.sh.
 */

/ {
    macros {
        pw1: pw1 {
            compatible = "zmk,behavior-macro";
            #binding-cells = <0>;
            bindings = <&none>;
        };

        pw2: pw2 {
            compatible = "zmk,behavior-macro";
            #binding-cells = <0>;
            bindings = <&none>;
        };
    };
};
